## boards/arm/sofle_mg_v1/Kconfig.board
```kconfig
#
# Copyright (c) 2024 The ZMK Contributors
# SPDX-License-Identifier: MIT
#

config BOARD_SOFLE_MG_V1_LEFT
    bool "sofle_mg_v1 left"
    depends on SOC_NRF52840_QIAA

config BOARD_SOFLE_MG_V1_RIGHT
    bool "sofle_mg_v1 right"
    depends on SOC_NRF52840_QIAA
```
